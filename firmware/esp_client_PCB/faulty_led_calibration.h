#pragma once
#include <Arduino.h>

// Enable ONLY on the unit with the replacement main LED strip at hole 6.
#ifndef FAULTY_LED_CALIBRATION
#define FAULTY_LED_CALIBRATION true
#endif

#if FAULTY_LED_CALIBRATION
// Source: 20261102-162100; camera/cutout-specific candidate.
#define FAULTY_LED_HOLE 6
static const uint8_t faultyLedKnots[17] = {0,8,16,24,32,48,64,80,96,112,128,160,192,208,224,240,255};
static const uint8_t faultyLedLut[4913][3] PROGMEM = {
  {0,0,0},
  {0,0,9},
  {0,0,18},
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  {107,115,160},
};

static void correctFaultyLed(uint8_t &r, uint8_t &g, uint8_t &b) {
  if (!(r || g || b)) return; // Explicit off must always stay off.
  // The measured lookup covers RGB sums up to 384. Outside that domain,
  // preserve the requested color instead of applying its legacy capped entries.
  if ((uint16_t)r + g + b > 384) return;
  uint8_t input[3] = {r,g,b}, lo[3];
  float t[3];
  for (uint8_t c=0;c<3;c++) {
    uint8_t i=0;
    while (i<15 && input[c]>faultyLedKnots[i+1]) ++i;
    lo[c]=i;
    t[c]=(float)(input[c]-faultyLedKnots[i])/(faultyLedKnots[i+1]-faultyLedKnots[i]);
  }
  uint8_t output[3];
  for (uint8_t c=0;c<3;c++) {
    float value=0;
    for (uint8_t a=0;a<2;a++) for (uint8_t d=0;d<2;d++) for (uint8_t e=0;e<2;e++) {
      uint16_t index=((lo[0]+a)*17+(lo[1]+d))*17+lo[2]+e;
      float weight=(a?t[0]:1-t[0])*(d?t[1]:1-t[1])*(e?t[2]:1-t[2]);
      value+=weight*pgm_read_byte(&faultyLedLut[index][c]);
    }
    output[c]=(uint8_t)constrain((int)value,0,255);
  }
  r=output[0];g=output[1];b=output[2];
}
#endif
